## esp32-h2-zigbee-window/sdkconfig.defaults
```kconfig
# Конфигурация для ESP32-H2 с ZigBee

# Настройки для целевой платформы ESP32-H2
CONFIG_IDF_TARGET="esp32h2"
CONFIG_IDF_TARGET_ESP32H2=y
CONFIG_IDF_TARGET_ARCH_RISCV=y

# Настройки ZigBee
CONFIG_ZB_ENABLED=y
CONFIG_ESP_ZB_PRIMARY_CHANNEL_MASK=0x7fff800
CONFIG_ESP_ZB_TX_POWER=20
CONFIG_ESP_ZB_RX_ON_WHEN_IDLE=y
CONFIG_ESP_ZB_FACTORY_RESET_ERASE_NETWORK_ONLY=y

# Включаем протокол 802.15.4
CONFIG_IEEE802154_ENABLED=y

# Настройки задач RTOS
CONFIG_FREERTOS_HZ=1000

# Настройки сна и энергосбережения
CONFIG_ESP_SLEEP_POWER_DOWN_FLASH=y
CONFIG_ESP_SLEEP_GPIO_RESET_WORKAROUND=y

# Настройки для сервоприводов
CONFIG_ESP32_SPIRAM_SUPPORT=y
CONFIG_ESP_DEFAULT_CPU_FREQ_MHZ_160=y
CONFIG_ESP_DEFAULT_CPU_FREQ_MHZ=160

# Настройки памяти
CONFIG_ESP_SYSTEM_EVENT_TASK_STACK_SIZE=4096
CONFIG_ESP_MAIN_TASK_STACK_SIZE=4096

# Настройки логирования
CONFIG_LOG_DEFAULT_LEVEL_INFO=y

# Настройки NVS
CONFIG_NVS_ENCRYPTION=y 
```

## sdkconfig.defaults
```kconfig
# Общие настройки
CONFIG_ESP_MAIN_TASK_STACK_SIZE=4096
CONFIG_FREERTOS_HZ=1000

# Настройки чипа ESP32-H2
CONFIG_IDF_TARGET="esp32h2"
CONFIG_ESP32H2_XTAL_FREQ_32=y

# Настройки ZigBee
CONFIG_ZB_ENABLED=y
CONFIG_ZB_RADIO_NATIVE=y

# Настройки для управления питанием
CONFIG_PM_ENABLE=y
CONFIG_ESP_SLEEP_POWER_DOWN_FLASH=y
CONFIG_ESP_SLEEP_GPIO_RESET_WORKAROUND=y

# Настройки ADC
CONFIG_ADC_CAL_EFUSE_TP_ENABLE=y
CONFIG_ADC_CAL_EFUSE_VREF_ENABLE=y
CONFIG_ADC_CAL_LUT_ENABLE=y

# Настройки OTA
CONFIG_BOOTLOADER_APP_ROLLBACK_ENABLE=y
CONFIG_OTA_ALLOW_HTTP=y
CONFIG_ESP_HTTPS_OTA_ALLOW_HTTP=y

# Настройки Wi-Fi (для резервного управления и OTA)
CONFIG_ESP_WIFI_STATIC_RX_BUFFER_NUM=16
CONFIG_ESP_WIFI_DYNAMIC_RX_BUFFER_NUM=32
CONFIG_ESP_WIFI_DYNAMIC_TX_BUFFER_NUM=32

# Настройки пинов GPIO
CONFIG_GPIO_ESP32H2_0_ENABLE=y  # Для ADC
CONFIG_GPIO_ESP32H2_4_ENABLE=y  # Для первого сервопривода
CONFIG_GPIO_ESP32H2_5_ENABLE=y  # Для второго сервопривода

# Настройки логирования
CONFIG_LOG_DEFAULT_LEVEL_INFO=y
CONFIG_LOG_COLORS=y

# Настройки флеш-памяти
CONFIG_ESPTOOLPY_FLASHSIZE_4MB=y 
```
